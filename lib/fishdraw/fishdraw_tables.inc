// Generated by tools/gentables.js from fishdraw.js (c) 2021 Lingdong Huang, MIT License.
// Do not edit by hand.

static const char* const BINOMEN_0[] = {"A","AB","AL","AN","AP","AR","AU","BA","BE","BO","BRA","CA","CAR","CENT","CHAE","CHAN","CHI","CHRO","CHRY","CO","CTE","CY","CYP","DE","E","EU","GA","GAS","GNA","GO","HE","HIP","HO","HY","LA","LAB","LE","LI","LO","LU","MAC","ME","MIC","MO","MU","MY","NA","NAN","NE","NO","O","ON","OP","OS","PA","PER","PHO","PI","PLA","PLEU","PO","PSEU","PTE","RA","RHI","RHOM","RU","SAL","SAR","SCA","SCOM","SE","SI","STE","TAU","TEL","THO","TRI","XE","XI"};
static const uint8_t BINOMEN_FREQ_0[] = {27,2,4,4,2,2,2,5,2,2,3,4,2,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2,3};
static const char* const BINOMEN_1[] = {"BE","BI","BO","BU","CA","CAM","CAN","CE","CENT","CHA","CHEI","CHI","CHO","CHY","CI","CIRR","CO","DI","DO","DON","DOP","GA","GAS","GO","HI","HYN","LA","LAB","LE","LEOT","LI","LICH","LIS","LO","LOS","LU","LY","MA","ME","MI","MICH","MO","MU","NA","NE","NEC","NI","NO","NOCH","NOP","NOS","PA","PE","PEN","PHA","PHI","PHO","PHY","PHYO","PI","PIP","PIS","PO","POG","POPH","RA","RAE","RAM","REOCH","RI","RICH","RIP","RIS","RO","ROI","ROP","ROS","RY","RYN","SE","SO","TA","TE","TEL","THAL","THE","THO","THOP","THU","TI","TICH","TO","TOG","TOP","TOS","VA","XI","XO"};
static const uint8_t BINOMEN_FREQ_1[] = {2,2,3,3,5,2,11,6,4,2,7,2,4,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2,2};
static const char* const BINOMEN_2[] = {"BIUS","BUS","CA","CHUS","CION","CON","CUS","DA","DES","DEUS","DON","DUS","GER","GON","GUS","HUS","LA","LEA","LIS","LIUS","LUS","MA","MIS","MUS","NA","NIA","NIO","NIUS","NOPS","NUS","PHEUS","PHIS","PIS","PUS","RA","RAS","RAX","RIA","RION","RIS","RUS","RYS","SA","SER","SIA","SIS","SUS","TER","TES","TEUS","THUS","THYS","TIA","TIS","TUS","TYS"};
static const uint8_t BINOMEN_FREQ_2[] = {3,3,7,7,3,2,3,2,5,2,13,7,2,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6,2};
static const char* const BINOMEN_3[] = {"A","AE","AL","AN","AR","AT","AU","AUST","AY","BA","BAR","BE","BI","BO","CA","CAL","CAM","CAN","CAR","CAU","CE","CHI","CHRY","COR","CRY","CU","CYA","DA","DE","DEN","DI","DIA","DO","DOR","DU","E","FA","FAS","FES","FI","FLO","FOR","FRE","FUR","GLA","GO","HA","HE","HIP","HO","HYP","I","IM","IN","JA","LA","LAB","LE","LEU","LI","LO","LU","MA","MAC","MAR","ME","MO","MOO","MOR","NA","NE","NI","NIG","NO","O","OR","PA","PAL","PE","PEC","PHO","PLA","PLU","PO","PRO","PU","PUL","RA","RE","RHOM","RI","RO","ROST","RU","SA","SAL","SE","SO","SPI","SPLEN","STRIA","TAU","THO","TRI","TY","U","UN","VA","VI","VIT","VUL","WAL","XAN"};
static const uint8_t BINOMEN_FREQ_3[] = {23,3,11,6,6,3,8,2,2,2,3,3,9,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2,2};
static const char* const BINOMEN_4[] = {"BA","BAR","BER","BI","BO","BOI","BU","CA","CAN","CAU","CE","CEL","CHA","CHEL","CHOP","CI","CIA","CIL","CIO","CO","COS","CU","DA","DE","DEL","DI","DIA","DO","FAS","FEL","FI","FOR","GA","GE","GI","HA","HYN","KE","LA","LAN","LE","LEA","LEU","LI","LIA","LO","LON","LOP","MA","ME","MEN","MI","MIE","MO","NA","NE","NEA","NEL","NEN","NI","NIF","NO","NOI","NOP","NU","PA","PE","PER","PHA","PHE","PI","PIN","PO","QUI","RA","RAC","RE","REN","RES","RI","RIA","RIEN","RIF","RO","ROR","ROS","ROST","RU","RYTH","SA","SE","SI","SO","SU","TA","TAE","TE","TER","THAL","THO","THU","TI","TIG","TO","TU","VA","VE","VES","VI","VIT","XEL","XI","ZO"};
static const uint8_t BINOMEN_FREQ_4[] = {5,2,2,4,4,2,2,10,6,2,3,5,3,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2,3};
static const char* const BINOMEN_5[] = {"BEUS","CA","CENS","CEPS","CEUS","CHA","CHUS","CI","CUS","DA","DAX","DENS","DES","DI","DIS","DUS","FER","GA","GI","GUS","KEI","KI","LA","LAS","LI","LIS","LIUS","LOR","LUM","LUS","MA","MIS","MUS","NA","NEUS","NI","NII","NIS","NIUS","NUS","PIS","PUS","RA","RE","RI","RIAE","RIE","RII","RIO","RIS","RIX","RONS","RU","RUM","RUS","SA","SEUS","SI","SIS","SUS","TA","TEUS","THUS","TI","TIS","TOR","TUM","TUS","TZI","ZI"};
static const uint8_t BINOMEN_FREQ_5[] = {2,7,4,3,5,2,5,2,13,6,2,2,6,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2,3};
static const uint8_t BINOMEN_COUNT[6] = {80,98,56,113,113,70};

static const char* const HERSHEY_UPPER[26] = {
  "  9I[RFJ[ RRFZ[ RMTWT",
  " 24G\\KFK[ RKFTFWGXHYJYLXNWOTP RKPTPWQXRYTYWXYWZT[K[",
  " 19H]ZKYIWGUFQFOGMILKKNKSLVMXOZQ[U[WZYXZV",
  " 16G\\KFK[ RKFRFUGWIXKYNYSXVWXUZR[K[",
  " 12H[LFL[ RLFYF RLPTP RL[Y[",
  "  9HZLFL[ RLFYF RLPTP",
  " 23H]ZKYIWGUFQFOGMILKKNKSLVMXOZQ[U[WZYXZVZS RUSZS",
  "  9G]KFK[ RYFY[ RKPYP",
  "  3NVRFR[",
  " 11JZVFVVUYTZR[P[NZMYLVLT",
  "  9G\\KFK[ RYFKT RPOY[",
  "  6HYLFL[ RL[X[",
  " 12F^JFJ[ RJFR[ RZFR[ RZFZ[",
  "  9G]KFK[ RKFY[ RYFY[",
  " 22G]PFNGLIKKJNJSKVLXNZP[T[VZXXYVZSZNYKXIVGTFPF",
  " 14G\\KFK[ RKFTFWGXHYJYMXOWPTQKQ",
  " 25G]PFNGLIKKJNJSKVLXNZP[T[VZXXYVZSZNYKXIVGTFPF RSWY]",
  " 17G\\KFK[ RKFTFWGXHYJYLXNWOTPKP RRPY[",
  " 21H\\YIWGTFPFMGKIKKLMMNOOUQWRXSYUYXWZT[P[MZKX",
  "  6JZRFR[ RKFYF",
  " 11G]KFKULXNZQ[S[VZXXYUYF",
  "  6I[JFR[ RZFR[",
  " 12F^HFM[ RRFM[ RRFW[ R\\FW[",
  "  6H\\KFY[ RYFK[",
  "  7I[JFRPR[ RZFRP",
  "  9H\\YFK[ RKFYF RK[Y["
};
static const char* const HERSHEY_LOWER[26] = {
  " 18I\\XMX[ RXPVNTMQMONMPLSLUMXOZQ[T[VZXX",
  " 18H[LFL[ RLPNNPMSMUNWPXSXUWXUZS[P[NZLX",
  " 15I[XPVNTMQMONMPLSLUMXOZQ[T[VZXX",
  " 18I\\XFX[ RXPVNTMQMONMPLSLUMXOZQ[T[VZXX",
  " 18I[LSXSXQWOVNTMQMONMPLSLUMXOZQ[T[VZXX",
  "  9MYWFUFSGRJR[ ROMVM",
  " 23I\\XMX]W`VaTbQbOa RXPVNTMQMONMPLSLUMXOZQ[T[VZXX",
  " 11I\\MFM[ RMQPNRMUMWNXQX[",
  "  9NVQFRGSFREQF RRMR[",
  " 12MWRFSGTFSERF RSMS^RaPbNb",
  "  9IZMFM[ RWMMW RQSX[",
  "  3NVRFR[",
  " 19CaGMG[ RGQJNLMOMQNRQR[ RRQUNWMZM\\N]Q][",
  " 11I\\MMM[ RMQPNRMUMWNXQX[",
  " 18I\\QMONMPLSLUMXOZQ[T[VZXXYUYSXPVNTMQM",
  " 18H[LMLb RLPNNPMSMUNWPXSXUWXUZS[P[NZLX",
  " 18I\\XMXb RXPVNTMQMONMPLSLUMXOZQ[T[VZXX",
  "  9KXOMO[ ROSPPRNTMWM",
  " 18J[XPWNTMQMNNMPNRPSUTWUXWXXWZT[Q[NZMX",
  "  9MYRFRWSZU[W[ ROMVM",
  " 11I\\MMMWNZP[S[UZXW RXMX[",
  "  6JZLMR[ RXMR[",
  " 12G]JMN[ RRMN[ RRMV[ RZMV[",
  "  6J[MMX[ RXMM[",
  " 10JZLMR[ RXMR[P_NaLbKb",
  "  9J[XMM[ RMMXM RM[X["
};
static const char* const HERSHEY_DOT = "  6MWRYQZR[SZRY";
